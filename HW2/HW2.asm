; Pooria Rahimi
; 99521289
; if first dip switch is on (lsb is 0): increment
; if first dip switch is off (lsb is 1): decremnt


.include "m32def.inc"
		LDI		R16,HIGH(RAMEND)
		OUT		SPH,R16
		LDI		R16,LOW(RAMEND)
		OUT		SPL,R16

		LDI		R16,0xFF
		OUT		DDRC,R16		;PORTC as output
		OUT		DDRD,R16		;PORTD as output

		OUT		PORTA,R16		;Enabling Pullup Resistor on PORTA 
		LDI		R16,0x00
		OUT		DDRA,R16		;PORTA as input

SET_ZERO:
		LDI		R16,0		
		LDI		R17,0			
		LDI		R18,0			
		LDI		R19,0			
		RJMP	DISPLAY

SET_9999:
		LDI		R16,9		
		LDI		R17,9			
		LDI		R18,9			
		LDI		R19,9			
		RJMP	DISPLAY

BEGIN:
		IN		R20,PINA
		ANDI	R20,0b00000001
		CPI		R20,0
		BRNE	DECREMENT

INCREMENT:
		CPI		R16,9
		BRLO	INC_YEKAN
		CPI		R17,9
		BRLO	INC_DAHGAN
		CPI		R18,9
		BRLO	INC_SADGAN
		CPI		R19,9
		BRLO	INC_HEZARGAN
		RJMP	SET_ZERO

INC_YEKAN:
		INC		R16
		RJMP	DISPLAY

INC_DAHGAN:
		LDI		R16,0
		INC		R17
		RJMP	DISPLAY

INC_SADGAN:
		LDI		R16,0
		LDI		R17,0
		INC		R18
		RJMP	DISPLAY

INC_HEZARGAN:
		LDI		R16,0
		LDI		R17,0
		LDI		R18,0
		INC		R19
		RJMP	DISPLAY

DECREMENT:
		CPI		R16,1
		BRSH	DEC_YEKAN
		CPI		R17,1
		BRSH	DEC_DAHGAN
		CPI		R18,1
		BRSH	DEC_SADGAN
		CPI		R19,1
		BRSH	DEC_HEZARGAN
		RJMP	SET_9999

DEC_YEKAN:
		DEC		R16
		RJMP	DISPLAY

DEC_DAHGAN:
		LDI		R16,9
		DEC		R17
		RJMP	DISPLAY

DEC_SADGAN:
		LDI		R16,9
		LDI		R17,9
		DEC		R18
		RJMP	DISPLAY

DEC_HEZARGAN:
		LDI		R16,9
		LDI		R17,9
		LDI		R18,9
		DEC		R19
		RJMP	DISPLAY

DISPLAY:
		LDI		R25,0b11111110	
		OUT		PORTD,R25
		MOV		R24,R19
		CALL	CONVERT
		OUT		PORTC,R24
		CALL	DELAY_DISP

		LDI		R25,0b11111101
		OUT		PORTD,R25
		MOV		R24,R18
		CALL	CONVERT
		OUT		PORTC,R24
		CALL	DELAY_DISP

		LDI		R25,0b11111011	
		OUT		PORTD,R25
		MOV		R24,R17
		CALL	CONVERT
		OUT		PORTC,R24
		CALL	DELAY_DISP

		LDI		R25,0b11110111	
		OUT		PORTD,R25
		MOV		R24,R16
		CALL	CONVERT
		OUT		PORTC,R24
		CALL	DELAY_DISP
		RJMP	BEGIN

DELAY_DISP:
		LDI		R21,0x01
L1:		LDI		R22,0x15
L2:		LDI		R23,0xFF
L3:		DEC		R23
		BRNE	L3
		DEC		R22
		BRNE	L2
		DEC		R21
		BRNE	L1
		RET

DELAY_CALC:
		LDI		R25,0x04
L4:		LDI		R26,0x1F
L5:		LDI		R27,0xFF
L6:		DEC		R27
		BRNE	L3
		DEC		R26
		BRNE	L2
		DEC		R25
		BRNE	L1
		RET


CONVERT:
		CPI		R24,0
		BRNE	C1
		LDI		R24,0x3F
		RET

C1:		CPI		R24,1
		BRNE	C2
		LDI		R24,0x06
		RET

C2:		CPI		R24,2
		BRNE	C3
		LDI		R24,0x5B
		RET

C3:		CPI		R24,3
		BRNE	C4
		LDI		R24,0x4F
		RET
C4:		CPI		R24,4
		BRNE	C5
		LDI		R24,0x66
		RET

C5:		CPI		R24,5
		BRNE	C6
		LDI		R24,0x6D
		RET

C6:		CPI		R24,6
		BRNE	C7
		LDI		R24,0x7D
		RET

C7:		CPI		R24,7
		BRNE	C8
		LDI		R24,0x07
		RET

C8:		CPI		R24,8
		BRNE	C9
		LDI		R24,0x7F
		RET

C9:		CPI		R24,9
		BRNE	C10
		LDI		R24,0x6F
C10:	RET

