;Pooria Rahimi
;99521289

.include "m32def.inc"
.ORG	0
		RJMP	BEGIN
.ORG	OC1Aaddr
		RJMP	ROUTINE1
.ORG	OC0addr
		RJMP	ROUTINE0	


BEGIN:	LDI		R16,HIGH(RAMEND)
		OUT		SPH,R16
		LDI		R16,LOW(RAMEND)
		OUT		SPL,R16

		LDI		R16,0xFF
		OUT		DDRC,R16		;PORTC as output
		OUT		DDRD,R16		;PORTD as output
		OUT		PORTA,R16		;Enabling Pullup Resistor on PORTA 
		LDI		R16,0x00
		OUT		DDRA,R16		;PORTA as input
		LDI		R24,0
		LDI		R25,0
		
		;Initialize TIMER0
		LDI		R16,0b00001001
		OUT		TCCR0,R16
		LDI		R16,200
		OUT		OCR0,R16
		
		;Initialize TIMER1
		LDI		R16,HIGH(11250-1)		;Set for 31250 counts
		OUT		OCR1AH,R16				;OCR1A1 = 31249
		LDI		R16,LOW(31250-1)
		OUT		OCR1AL,R16
		LDI		R16,0b00000000			;CTC: TOP=OCR1A
		OUT		TCCR1A,R16
		LDI		R16,0b00001100			;Prescaler = 256
		OUT		TCCR1B,R16
		LDI		R16,0b00010010			;Enable OCF1A interrupt
		OUT		TIMSK,R16
		
		SEI

MAIN:

B1:		LDI		R20,0
		LDI		R21,0
		LDI		R22,0
		LDI		R23,0

		MOV	R26,R24
D0:		CPI		R26,10
		BRLO	D1
		LDI		R18,10
		SUB		R26,R18
		INC		R22				;Dahgan
		RJMP	D0
D1:		MOV		R23,R26			;Yekan
		
		MOV	R26,R25
D2:		CPI		R26,10
		BRLO	D3
		LDI		R18,10
		SUB		R26,R18
		INC		R20			;Hezaregan
		RJMP	D2
D3:		MOV	R21,R26			;Sadgan
	    CALL	DIS
		RJMP	MAIN
		

	
DISPLAY:	
	    RJMP	L12
		LDI		R16,0b11111110	;displaying Hezaregan
		OUT		PORTD,R16
		MOV		R16,R20
		CALL	CONVERT
		OUT		PORTC,R16
		CALL	DELAY

		LDI		R16,0b11111101	;displaying Sadgan
		OUT		PORTD,R16
		MOV		R16,R21
		CALL	CONVERT
		OUT		PORTC,R16
		CALL	DELAY

		LDI		R16,0b11111011	;displaying Dahgan
		OUT		PORTD,R16
		MOV		R16,R22
		CALL	CONVERT
		OUT		PORTC,R16
		CALL	DELAY

		LDI		R16,0b11110111	;displaying Yekan
		OUT		PORTD,R16
		MOV		R16,R23
		CALL	CONVERT
		OUT		PORTC,R16
		CALL	DELAY
L12:	RET

CHSE:	LDI		R28,0x01
	    IN		R27,PINA
		AND	R28,R27
		CPI		R28,0
		BREQ	CH1				;INCR
		RJMP	CH2				;DECR
CH1:	CALL	INCR
	    RJMP	CH3
CH2:	CALL	DECR
CH3:	RET
		
INCR:	INC		R24
	    CPI		R24,100
		BRLO	I1
		LDI		R24,0
		INC		R25
		CPI		R25,100
		BRLO	I1
		LDI		R25,0
I1:		RET

DECR:	CPI		R24,0
	    BREQ	DE1		
		DEC		R24	
		RJMP	DE3
DE1:	LDI		R24,99
		CPI		R25,0
	    BREQ	DE2
		DEC		R25
		RJMP	DE3
DE2:	LDI		R25,99
DE3:	RET

DELAY:	LDI		R17,0x01
L1:		LDI		R18,0x01
L2:		LDI		R19,0xFF
L3:		DEC		R19
		BRNE	L3
		DEC		R18
		BRNE	L2
		DEC		R17
		BRNE	L1
		RET

ROUTINE0:
		CLI
	    CALL	DISPLAY
		SEI
	    RETI
		
ROUTINE1:
	    CLI
		CALL 	CHSE
		SEI
	    RETI
		
CONVERT:				;converts a digit to 7seg code 
		CPI		R16,0
		BRNE	C1
		LDI		R16,0x3F
		RET
C1:		CPI		R16,1
		BRNE	C2
		LDI		R16,0x06
		RET
C2:		CPI		R16,2
		BRNE	C3
		LDI		R16,0x5B
		RET
C3:		CPI		R16,3
		BRNE	C4
		LDI		R16,0x4F
		RET
C4:		CPI		R16,4
		BRNE	C5
		LDI		R16,0x66
		RET
C5:		CPI		R16,5
		BRNE	C6
		LDI		R16,0x6D
		RET
C6:		CPI		R16,6
		BRNE	C7
		LDI		R16,0x7D
		RET
C7:		CPI		R16,7
		BRNE	C8
		LDI		R16,0x07
		RET
C8:		CPI		R16,8
		BRNE	C9
		LDI		R16,0x7F
		RET
C9:		CPI		R16,9
		BRNE	C10
		LDI		R16,0x6F
C10:	RET

DIS:	
		LDI		R16,0b11111110	;displaying Hezaregan
		OUT		PORTD,R16
		MOV		R16,R20
		CALL	CONVERT
		OUT		PORTC,R16
		CALL	DELAY

		LDI		R16,0b11111101	;displaying Sadgan
		OUT		PORTD,R16
		MOV		R16,R21
		CALL	CONVERT
		OUT		PORTC,R16
		CALL	DELAY

		LDI		R16,0b11111011	;displaying Dahgan
		OUT		PORTD,R16
		MOV		R16,R22
		CALL	CONVERT
		OUT		PORTC,R16
		CALL	DELAY

		LDI		R16,0b11110111	;displaying Yekan
		OUT		PORTD,R16
		MOV		R16,R23
		CALL	CONVERT
		OUT		PORTC,R16
		CALL	DELAY
		RET
